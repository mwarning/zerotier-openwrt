## zerotier/Config.in
```kconfig
menu "Configuration"
	depends on PACKAGE_zerotier

config ZEROTIER_ENABLE_DEBUG
	bool "Build in debug mode"
	depends on PACKAGE_zerotier
	default n

config ZEROTIER_ENABLE_NETWORK_CONTROLLER
	bool "Build with network controller"
	depends on PACKAGE_zerotier
	default n

endmenu
```
